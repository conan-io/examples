## features/buildroot/package/conan-gtest/Config.in
```kconfig
config BR2_PACKAGE_CONAN_GTEST
	bool "conan-gtest"
	help
	  Google Testing and Mocking Framework

	  https://github.com/google/googletest
```

## features/buildroot/package/conan-zlib/Config.in
```kconfig
config BR2_PACKAGE_CONAN_ZLIB
	bool "conan-zlib"
	help
	  Standard (de)compression library. Used by things like
	  gzip and libpng.

	  http://www.zlib.net
```

## features/buildroot/package/conan/Config.in
```kconfig
choice
	prompt "Build policy"

config CONAN_BUILD_POLICY_MISSING
	bool "missing"
    help
	  It will build only the missing requires.

config CONAN_BUILD_POLICY_OUTDATED
	bool "outdated"
	help
	  It will try to build from code if the binary is
	  not built with the current recipe or when missing binary package.

config CONAN_BUILD_POLICY_CASCADE
	bool "cascade"
	help
	  It will build from code all the nodes with some dependency being
	  built (for any reason). Can be used together with any other build
	  policy. Useful to make sure that any new change introduced in a
	  dependency is incorporated by building again the package.

config CONAN_BUILD_POLICY_ALWAYS
	bool "always"
	help
	  The always policy will retrieve the sources each time the package
	  is installed, so it can be useful for providing a “latest” mechanism
	  or ignoring the uploaded binary packages.

config CONAN_BUILD_POLICY_NEVER
	bool "never"
	help
	  Never build, use binary packages or fail if a binary package is not found.

endchoice

config CONAN_REMOTE_NAME
	string "Conan remote name"
    help
	  Look in the specified remote server.
```

## features/buildroot/package/hello-world/Config.in
```kconfig
config BR2_PACKAGE_HELLO_WORLD
    bool "hello-world"
	depends on BR2_PACKAGE_CONAN_ZLIB
    help
        Hello world package.

        http://example.com
```

## features/buildroot/package/python-conan/Config.in.host
```kconfig
config BR2_PACKAGE_HOST_PYTHON_CONAN
	bool "host python-conan"
	depends on BR2_PACKAGE_PYTHON3
	help
	  Decentralized, open-source, C/C++ package manager

	  https://conan.io
```

## features/buildroot/package/python-patch/Config.in
```kconfig
config BR2_PACKAGE_PYTHON_PATCH
	bool "python-patch"
	help
	  Library to parse and apply unified diffs

	  https://github.com/techtonik/python-patch
```

## features/buildroot/package/python-pluginbase/Config.in
```kconfig
config BR2_PACKAGE_PYTHON_PLUGINBASE
	bool "python-pluginbase"
	depends on BR2_PACKAGE_PYTHON3
	help
	  PluginBase is a module for Python that enables the development of \
	  flexible plugin systems in Python.

	  http://github.com/mitsuhiko/pluginbase
```

## features/buildroot/package/python-pluginbase/Config.in.host
```kconfig
config BR2_PACKAGE_HOST_PYTHON_PLUGINBASE
	bool "host-python-pluginbase"
	depends on BR2_PACKAGE_PYTHON3
	help
	  PluginBase is a module for Python that enables the development of \
	  flexible plugin systems in Python.

	  http://github.com/mitsuhiko/pluginbase
```
